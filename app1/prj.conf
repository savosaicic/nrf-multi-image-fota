## CMakeLists.txt
```
cmake_minimum_required(VERSION 3.20.0)

find_package(Zephyr REQUIRED HINTS $ENV{ZEPHYR_BASE})
project(app1)

target_include_directories(app PRIVATE include)
target_sources(app PRIVATE
  src/main.c
  src/firmware_update.c
)
```

## prj.conf
```kconfig
# General
CONFIG_LOG=y
CONFIG_REBOOT=y

# TF-M
CONFIG_TFM_PROFILE_TYPE_MINIMAL=y

# Heap and stacks
CONFIG_HEAP_MEM_POOL_SIZE=32768
CONFIG_MAIN_STACK_SIZE=8192
CONFIG_SYSTEM_WORKQUEUE_STACK_SIZE=4096

# Nrf modem
CONFIG_NRF_MODEM_LIB=y
CONFIG_MODEM_INFO=y
CONFIG_LTE_LINK_CONTROL=y
CONFIG_MODEM_KEY_MGMT=y # Needed by lwm2m_client_utils

# Networking
CONFIG_NETWORKING=y
CONFIG_NET_SOCKETS=y
CONFIG_NET_SOCKETS_OFFLOAD=y
CONFIG_DNS_RESOLVER=y

# LwM2M
CONFIG_LWM2M=y
CONFIG_LWM2M_COAP_BLOCK_SIZE=512
CONFIG_LWM2M_ENGINE_MAX_MESSAGES=10
CONFIG_LWM2M_ENGINE_MAX_OBSERVER=5
CONFIG_LWM2M_FIRMWARE_UPDATE_OBJ_SUPPORT=n
CONFIG_LWM2M_FIRMWARE_UPDATE_PULL_SUPPORT=y
CONFIG_LWM2M_RW_OMA_TLV_SUPPORT=y
CONFIG_LWM2M_CLIENT_UTILS=y
CONFIG_LWM2M_CLIENT_UTILS_SERVER="coap://<server>:5683"
CONFIG_LWM2M_CLIENT_UTILS_ADV_FIRMWARE_UPDATE_OBJ_SUPPORT=y
CONFIG_LWM2M_CLIENT_UTILS_ADV_FOTA_INSTANCE_COUNT=3
CONFIG_FOTA_CLIENT_AUTOSCHEDULE_UPDATE=n
CONFIG_LWM2M_CLIENT_UTILS_LOG_LEVEL_DBG=y

# FOTA download
CONFIG_FOTA_DOWNLOAD=y
CONFIG_DOWNLOADER=y
CONFIG_DOWNLOADER_STACK_SIZE=4096

# External flash (secondary slot)
CONFIG_GPIO=y
CONFIG_SPI=y
CONFIG_SPI_NOR=y
CONFIG_SPI_NOR_SFDP_DEVICETREE=y
CONFIG_SPI_NOR_FLASH_LAYOUT_PAGE_SIZE=4096
# QSPI drivers are enabled by defualt for some chips.
# Disable it explicitly to be sure QSPI is disabled.
CONFIG_NORDIC_QSPI_NOR=n

# DFU target
CONFIG_DFU_TARGET=y
CONFIG_DFU_TARGET_MCUBOOT=y
CONFIG_DFU_TARGET_MODEM_DELTA=y
# 3 = app0(img0) + app1(img1) + mcuboot-s0/s1, matches MCUboot's slot table.
# APP_SYNC disabled in sysbuild.conf so sysbuild doesn't override this with 2.
CONFIG_UPDATEABLE_IMAGE_NUMBER=3
CONFIG_IMG_MANAGER=y
CONFIG_FLASH=y
CONFIG_FLASH_MAP=y
CONFIG_STREAM_FLASH=y
CONFIG_IMG_ERASE_PROGRESSIVELY=y

# Settings (required for FOTA state persistence)
CONFIG_SETTINGS_NVS=y
CONFIG_NVS=y
CONFIG_FLASH_MAP=y
CONFIG_SETTINGS=y
```

## src/main.c
```c
#include <modem/lte_lc.h>
#include <zephyr/kernel.h>
#include <zephyr/logging/log.h>
#include <zephyr/net/lwm2m.h>
#include <zephyr/sys/reboot.h>
#include <modem/nrf_modem_lib.h>
#include <zephyr/drivers/gpio.h>
#include <net/lwm2m_client_utils.h>

#include "firmware_update.h"

LOG_MODULE_REGISTER(fota_lwm2m);

#define ENDPOINT_NAME "your-endpoint-name"
#define LIFETIME_S    (60 * 5)

static K_SEM_DEFINE(lte_connected, 0, 1);

static const char manufacturer[] = "Nordic Semiconductor";
static const char model[]        = "nRF9151-DK";
static const char serial[]       = "SN-001";
static const char fw_ver[]       = "1.0.0";

static struct lwm2m_ctx client_ctx;

#define SLEEP_TIME_MS 1000
#define LED0_NODE DT_ALIAS(led0)
static const struct gpio_dt_spec led = GPIO_DT_SPEC_GET(LED0_NODE, gpios);

static void lte_handler(const struct lte_lc_evt *const evt)
{
  switch (evt->type) {
  case LTE_LC_EVT_NW_REG_STATUS:
    if (evt->nw_reg_status != LTE_LC_NW_REG_REGISTERED_HOME &&
        evt->nw_reg_status != LTE_LC_NW_REG_REGISTERED_ROAMING) {
      break;
    }
    LOG_INF("LTE registered: %s",
            evt->nw_reg_status == LTE_LC_NW_REG_REGISTERED_HOME ? "home network"
                                                                : "roaming");
    k_sem_give(&lte_connected);
    break;

  case LTE_LC_EVT_RRC_UPDATE:
    LOG_INF("RRC mode: %s",
            evt->rrc_mode == LTE_LC_RRC_MODE_CONNECTED ? "connected" : "idle");
    break;
  default:
    break;
  }
}

static int modem_configure(void)
{
  int err;

  LOG_INF("Initializing modem library");
  err = nrf_modem_lib_init();
  if (err) {
    LOG_ERR("Failed to initialize the modem library, error: %d", err);
    return err;
  }

  LOG_INF("Connecting to LTE network");
  err = lte_lc_connect_async(lte_handler);
  if (err) {
    LOG_ERR("lte_lc_connect_async failed: %d", err);
    return err;
  }

  k_sem_take(&lte_connected, K_FOREVER);
  LOG_INF("Connected to LTE network");

  return 0;
}

static void observe_cb(enum lwm2m_observe_event event,
                       struct lwm2m_obj_path *path, void *user_data)
{
  char buf[LWM2M_MAX_PATH_STR_SIZE];

  switch (event) {
  case LWM2M_OBSERVE_EVENT_OBSERVER_ADDED:
    LOG_INF("Observer added for %s", lwm2m_path_log_buf(buf, path));
    break;
  case LWM2M_OBSERVE_EVENT_OBSERVER_REMOVED:
    LOG_INF("Observer removed for %s", lwm2m_path_log_buf(buf, path));
    break;
  case LWM2M_OBSERVE_EVENT_NOTIFY_ACK:
    LOG_INF("Notify ACK for %s", lwm2m_path_log_buf(buf, path));
    break;
  case LWM2M_OBSERVE_EVENT_NOTIFY_TIMEOUT:
    LOG_WRN("Notify timeout for %s — triggering reg update",
            lwm2m_path_log_buf(buf, path));
    lwm2m_rd_client_update();
    break;
  }
}

static void rd_client_event(struct lwm2m_ctx *client,
                            enum lwm2m_rd_client_event event)
{
  switch (event) {
  case LWM2M_RD_CLIENT_EVENT_NONE:
    break;
  case LWM2M_RD_CLIENT_EVENT_BOOTSTRAP_REG_FAILURE:
    LOG_ERR("Bootstrap registration failure");
    break;
  case LWM2M_RD_CLIENT_EVENT_BOOTSTRAP_REG_COMPLETE:
    LOG_INF("Bootstrap registration complete");
    break;
  case LWM2M_RD_CLIENT_EVENT_BOOTSTRAP_TRANSFER_COMPLETE:
    LOG_INF("Bootstrap transfer complete");
    break;
  case LWM2M_RD_CLIENT_EVENT_REGISTRATION_FAILURE:
    LOG_ERR("Registration failure");
    break;
  case LWM2M_RD_CLIENT_EVENT_REGISTRATION_COMPLETE:
    LOG_INF("Registration complete");
    break;
  case LWM2M_RD_CLIENT_EVENT_REG_TIMEOUT:
    LOG_WRN("Registration timeout");
    break;
  case LWM2M_RD_CLIENT_EVENT_REG_UPDATE_COMPLETE:
    LOG_INF("Registration update complete");
    break;
  case LWM2M_RD_CLIENT_EVENT_DEREGISTER_FAILURE:
    LOG_ERR("Deregister failure");
    break;
  case LWM2M_RD_CLIENT_EVENT_DISCONNECT:
    LOG_WRN("Disconnected");
    break;
  case LWM2M_RD_CLIENT_EVENT_QUEUE_MODE_RX_OFF:
    LOG_DBG("Queue mode RX window closed");
    break;
  case LWM2M_RD_CLIENT_EVENT_ENGINE_SUSPENDED:
    LOG_DBG("Engine suspended");
    break;
  case LWM2M_RD_CLIENT_EVENT_SERVER_DISABLED:
    LOG_DBG("Server disabled");
    break;
  case LWM2M_RD_CLIENT_EVENT_REG_UPDATE:
    LOG_DBG("Registration update sent");
    break;
  case LWM2M_RD_CLIENT_EVENT_DEREGISTER:
    LOG_DBG("Deregister sent");
    break;

  /*
   * NETWORK_ERROR must call lwm2m_rd_client_stop()
   * Failing to do so leaves the engine in a broken state
   */
  case LWM2M_RD_CLIENT_EVENT_NETWORK_ERROR:
    LOG_ERR("Network error, stopping client");
    lwm2m_rd_client_stop(client, rd_client_event, true);
    break;
  }
}

static int device_reboot_cb(uint16_t obj_inst_id, uint8_t *args,
                            uint16_t args_len)
{
  LOG_INF("Reboot requested by server");
  sys_reboot(SYS_REBOOT_COLD);
  return 0;
}

static void setup_server_object(void)
{
  /* Short Server ID is set by lwm2m_client_utils lib */

  /* Resource 1: Lifetime */
  lwm2m_set_u32(&LWM2M_OBJ(1, 0, 1), LIFETIME_S);

  /* Resource 6: Notification storing while disabled/offline */
  lwm2m_set_bool(&LWM2M_OBJ(1, 0, 6), false);

  /* Resource 7: Binding: "U" = UDP */
  lwm2m_set_string(&LWM2M_OBJ(1, 0, 7), "U");
}

static void setup_device_object(void)
{
  lwm2m_set_res_buf(&LWM2M_OBJ(3, 0, 0), (void *)manufacturer,
                    sizeof(manufacturer), sizeof(manufacturer),
                    LWM2M_RES_DATA_FLAG_RO);
  lwm2m_set_res_buf(&LWM2M_OBJ(3, 0, 1), (void *)model, sizeof(model),
                    sizeof(model), LWM2M_RES_DATA_FLAG_RO);
  lwm2m_set_res_buf(&LWM2M_OBJ(3, 0, 2), (void *)serial, sizeof(serial),
                    sizeof(serial), LWM2M_RES_DATA_FLAG_RO);
  lwm2m_set_res_buf(&LWM2M_OBJ(3, 0, 3), (void *)fw_ver, sizeof(fw_ver),
                    sizeof(fw_ver), LWM2M_RES_DATA_FLAG_RO);

  lwm2m_register_exec_callback(&LWM2M_OBJ(3, 0, 4), device_reboot_cb);
}

static int lwm2m_setup(void)
{
  int ret;

  /* Writes server URL from Kconfig and sets NoSec mode */
  ret = lwm2m_init_security(&client_ctx, ENDPOINT_NAME, NULL);
  if (ret < 0) {
    LOG_ERR("Failed to init security object: %d", ret);
    return ret;
  }

  setup_server_object();
  setup_device_object();

  ret = setup_firmware_object();
  if (ret < 0) {
    LOG_ERR("failed to setup firmware object: %d", ret);
    return ret;
  }

  return 0;
}

void client_acknowledge(void)
{
	lwm2m_acknowledge(&client_ctx);
}

int main(void)
{
  int ret;

  LOG_INF("*** APP1 from app0 ***");

  if (!gpio_is_ready_dt(&led)) {
    return 0;
  }
  ret = gpio_pin_configure_dt(&led, GPIO_OUTPUT_ACTIVE);
  if (ret < 0) {
    return 0;
  }

  ret = modem_configure();
  if (ret) {
    LOG_ERR("modem_configure failed: %d", ret);
    return ret;
  }

  LOG_INF("Starting LwM2M client");
  memset(&client_ctx, 0, sizeof(client_ctx));
  ret = lwm2m_setup();
  if (ret < 0) {
    LOG_ERR("LwM2M setup failed: %d", ret);
    return ret;
  }

  lwm2m_rd_client_start(&client_ctx, ENDPOINT_NAME, 0, rd_client_event,
                        observe_cb);

  while (1) {
    ret = gpio_pin_toggle_dt(&led);
    if (ret < 0) {
      return 0;
    }

    k_msleep(SLEEP_TIME_MS);
  }

  return 0;
}
```

## src/firmware_update.c
```c
#include <zephyr/kernel.h>
#include <zephyr/logging/log.h>
#include <zephyr/net/lwm2m.h>
#include <zephyr/sys/reboot.h>

#include <net/lwm2m_client_utils.h>

LOG_MODULE_REGISTER(firmware_update);

static int fota_event_cb(struct lwm2m_fota_event *event)
{
  switch (event->id) {
  case LWM2M_FOTA_DOWNLOAD_START:
    LOG_INF("Download started, instance %d", event->download_start.obj_inst_id);
    break;
  case LWM2M_FOTA_DOWNLOAD_FINISHED:
    LOG_INF("Download done, DFU type: %d", event->download_ready.dfu_type);
    break;
  case LWM2M_FOTA_UPDATE_IMAGE_REQ:
    /* Return 0 to accept, negative to defer */
    LOG_INF("Update requested, instance %d", event->update_req.obj_inst_id);
    return 0;
  case LWM2M_FOTA_UPDATE_MODEM_RECONNECT_REQ:
    /* TODO: Modem update requires LTE reconnection
     * handle it here to avoid rebooting
     */
    LOG_INF("Modem update applied, rebooting");
    return -1; /* Let the lib handle the reboot */
  case LWM2M_FOTA_UPDATE_ERROR:
    LOG_ERR("Update failed on instance %d, code %d", event->failure.obj_inst_id,
            event->failure.update_failure);
    break;
  }
  return 0;
}

/* MCUboot image pair index of this binary */
#define APP_MCUBOOT_IMG_NUM 1

int setup_firmware_object(void)
{
  int ret;

  ret = lwm2m_adv_firmware_mcuboot_inst_add("app0", 0);
  if (ret < 0) {
    LOG_ERR("Failed to register app0 MCUboot pair: %d", ret);
    return ret;
  }
  ret = lwm2m_adv_firmware_mcuboot_inst_add("app1", 1);
  if (ret < 0) {
    LOG_ERR("Failed to register app1 MCUboot pair: %d", ret);
    return ret;
  }

  ret = lwm2m_init_firmware_cb(fota_event_cb);
  if (ret < 0) {
    LOG_ERR("Failed to init firmware callback: %d", ret);
    return ret;
  }

  /* Call once at boot to confirm MCUboot image and sync result to server */
  ret = lwm2m_init_image_multi(APP_MCUBOOT_IMG_NUM);
  if (ret < 0) {
    LOG_ERR("Failed to setup image properties: %d", ret);
    return ret;
  }

  return 0;
}
```
